## drivers/staging/Kconfig.rej
```kconfig
--- drivers/staging/Kconfig
+++ drivers/staging/Kconfig
@@ -94,4 +94,7 @@
 source "drivers/staging/android/Kconfig"
 
 endif # !STAGING_EXCLUDE_BUILD
+
+source "drivers/staging/ramzswap/Kconfig"
+
 endif # STAGING
```
